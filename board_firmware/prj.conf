## prj.conf
```kconfig
CONFIG_GPIO=y
CONFIG_DISPLAY=y
CONFIG_MICROBIT_DISPLAY=y
CONFIG_SYS_CLOCK_TICKS_PER_SEC=250

# Bluetooth
CONFIG_BT=y
#CONFIG_BT_DEBUG_LOG=y
CONFIG_BT_SMP=y
CONFIG_BT_PERIPHERAL=y
CONFIG_BT_GATT_DIS=y
CONFIG_BT_GATT_DIS_PNP=n
CONFIG_BT_DEVICE_NAME="Web BBC:Microbit"
CONFIG_BT_DEVICE_APPEARANCE=833
```

## src/main.c
```c
#include <zephyr.h>
#include <misc/printk.h>
#include <gpio.h>
#include <device.h>
#include <stdio.h>

#include <bluetooth/bluetooth.h>
#include <bluetooth/hci.h>
#include <bluetooth/conn.h>
#include <bluetooth/uuid.h>
#include <bluetooth/gatt.h>

#include <display/mb_display.h>

#include "gatt_service.h"
#include "button_handler.h"
#include "microbit_display.h"

// BT Advertised service(s)
static const struct bt_data ad[] = {
	BT_DATA_BYTES(BT_DATA_FLAGS, (BT_LE_AD_GENERAL | BT_LE_AD_NO_BREDR)),
	BT_DATA_BYTES(BT_DATA_UUID128_ALL,
		      0xf0, 0xde, 0xbc, 0x9a, 0x78, 0x56, 0x34, 0x12,
		      0x78, 0x56, 0x34, 0x12, 0x78, 0x56, 0x34, 0x12),
};

static void connected(struct bt_conn *conn, u8_t err)
{
	if (err) {
		printk("Connection failed (err %u)\n", err);
		mb_show_smiley(false);
	} else {
		printk("Connected\n");
		mb_show_smiley(true);
	}
}

static void disconnected(struct bt_conn *conn, u8_t reason)
{
	printk("Disconnected (reason %u)\n", reason);
	mb_show_smiley(false);
}

static struct bt_conn_cb conn_callbacks = {
	.connected = connected,
	.disconnected = disconnected,
};

static void bt_ready(int err)
{
	if (err) {
		printk("Bluetooth init failed (err %d)\n", err);
		return;
	}

	printk("Bluetooth initialized\n");

	gatt_service_init();

	err = bt_le_adv_start(BT_LE_ADV_CONN_NAME, ad, ARRAY_SIZE(ad), NULL, 0);
	if (err) {
		printk("Advertising failed to start (err %d)\n", err);
		return;
	}

	printk("Advertising successfully started\n");
}

void main(void)
{
	int err;

	// Init Bluetooth Low Energy.	
	err = bt_enable(bt_ready);
	if (err) {
		printk("Bluetooth init failed (err %d)\n", err);
		return;
	}

	bt_conn_cb_register(&conn_callbacks);

	// Init button handler.
	button_handler_init();

	// Show a small animation show the board is ready.
	mb_show_ready_animation();

	while (1) {
		// Every second...
		k_sleep(1000);
		
		// ...send 'heartbeat' count over GATT
		send_message(GATT_MSG_HEARTBEAT, NULL, 0);
	}
}
```

## src/button_handler.c
```c
#include <zephyr.h>
#include <misc/printk.h>
#include <gpio.h>
#include <device.h>

#include "gatt_service.h"
#include "button_handler.h"

struct device *button_device;

u8_t data_buf[3];

static void button_pressed(struct device *dev, struct gpio_callback *cb,
		 uint32_t pins)
{
    u8_t btn = -1;
    u32_t val;

    if (pins & BIT(SW0_GPIO_PIN))
    {
        btn = 0;
        gpio_pin_read(button_device, SW0_GPIO_PIN, &val);
    }
    else if(pins & BIT(SW1_GPIO_PIN))
    {
        btn = 1;
        gpio_pin_read(button_device, SW1_GPIO_PIN, &val);
    }
    if (btn != -1)
    {
        data_buf[0] = 0x10; // BTN ACTION
        data_buf[1] = btn;
        data_buf[2] = val == 1 ? 0 : 1;
        send_message(GATT_MSG_DATA, data_buf, 3);
    	printk("Buttons[%s] %s\n", btn == 0 ? "LEFT" : "RIGHT", val == 1 ? "RELEASED" : "PRESSED");
    }
}

void button_handler_init()
{	static struct gpio_callback button_cb;

	button_device = device_get_binding(SW0_GPIO_CONTROLLER);
	gpio_pin_configure(button_device, SW0_GPIO_PIN, (GPIO_DIR_IN | GPIO_INT | GPIO_INT_EDGE | GPIO_PUD_PULL_UP | GPIO_INT_DEBOUNCE | GPIO_INT_DOUBLE_EDGE));
	gpio_pin_configure(button_device, SW1_GPIO_PIN, (GPIO_DIR_IN | GPIO_INT | GPIO_INT_EDGE | GPIO_PUD_PULL_UP | GPIO_INT_DEBOUNCE | GPIO_INT_DOUBLE_EDGE));
	gpio_init_callback(&button_cb, button_pressed, BIT(SW0_GPIO_PIN) | BIT(SW1_GPIO_PIN));
	gpio_add_callback(button_device, &button_cb);
	gpio_pin_enable_callback(button_device, SW0_GPIO_PIN);
	gpio_pin_enable_callback(button_device, SW1_GPIO_PIN);
}
```

## src/button_handler.h
```c
#ifndef __BUTTON_HANDLER_H__
#define __BUTTON_HANDLER_H__

void button_handler_init(void);

#endif
```

## src/gatt_service.c
```c
#include <zephyr/types.h>
#include <stddef.h>
#include <string.h>
#include <stdio.h>
#include <errno.h>
#include <misc/printk.h>
#include <misc/byteorder.h>
#include <zephyr.h>

#include <bluetooth/bluetooth.h>
#include <bluetooth/hci.h>
#include <bluetooth/conn.h>
#include <bluetooth/uuid.h>
#include <bluetooth/gatt.h>

#include "gatt_service.h"
#include "microbit_display.h"


static struct bt_gatt_ccc_cfg  heartbeat_ccc_cfg[BT_GATT_CCC_MAX] = {};
static u8_t notify_heartbeat;

static struct bt_gatt_ccc_cfg  data_ccc_cfg[BT_GATT_CCC_MAX] = {};
static u8_t notify_data;

// NOTE: Use a proper GATT UUID for production.
static struct bt_uuid_128 service_uuid = BT_UUID_INIT_128(
	0xf0, 0xde, 0xbc, 0x9a, 0x78, 0x56, 0x34, 0x12,
	0x78, 0x56, 0x34, 0x12, 0x78, 0x56, 0x34, 0x12);

static struct bt_uuid_128 heartbeat_char_uuid = BT_UUID_INIT_128(
	0xf1, 0xde, 0xbc, 0x9a, 0x78, 0x56, 0x34, 0x12,
	0x78, 0x56, 0x34, 0x12, 0x78, 0x56, 0x34, 0x12);

static struct bt_uuid_128 data_char_uuid = BT_UUID_INIT_128(
	0xf2, 0xde, 0xbc, 0x9a, 0x78, 0x56, 0x34, 0x12,
	0x78, 0x56, 0x34, 0x12, 0x78, 0x56, 0x34, 0x12);

static struct bt_uuid_128 cmd_char_uuid = BT_UUID_INIT_128(
	0xf3, 0xde, 0xbc, 0x9a, 0x78, 0x56, 0x34, 0x12,
	0x78, 0x56, 0x34, 0x12, 0x78, 0x56, 0x34, 0x12);


typedef struct notify_msg_t {
	u8_t type;
	u8_t data[20];
	u16_t len;
} notify_msg_t;

#define NOTIFY_BUFFER_LEN_LOG2 (4)
#define NOTIFY_BUFFER_LEN (1<<NOTIFY_BUFFER_LEN_LOG2)

static struct k_work gatt_notify_work;
static notify_msg_t notify_buf[NOTIFY_BUFFER_LEN];
static u8_t next_buf_idx = 0;
static u8_t next_notify_idx = 0;

void gatt_service_heartbeat_notify();
void gatt_service_data_notify(const void *buf, u16_t len);

void send_message(u8_t type, u8_t* data, u16_t len)
{
	if (len > 20) {
		return;
	}

	notify_msg_t* msg = &notify_buf[next_buf_idx];
	next_buf_idx = (next_buf_idx+1) & (NOTIFY_BUFFER_LEN-1);

	msg->type = type;

	if (data && len) {
		msg->len = len;
		memcpy(msg->data, data, len);
	}
}

static u32_t hearbeat_count = 0;

static void send_next_notification(struct k_work *work)
{
	if (next_buf_idx == next_notify_idx) {
		k_sleep(50);
		k_work_submit(&gatt_notify_work);
		return;
	}

	notify_msg_t* msg = &notify_buf[next_notify_idx];
	next_notify_idx = (next_notify_idx+1) & (NOTIFY_BUFFER_LEN-1);

	if (msg->type == GATT_MSG_DATA) {
		gatt_service_data_notify(msg->data, msg->len);
	} else if (msg->type == GATT_MSG_HEARTBEAT) {
		hearbeat_count++;
		gatt_service_heartbeat_notify();
		printk("Heartbeat[%d]\n", hearbeat_count);
	}

	k_work_submit(&gatt_notify_work);
}

static void heartbeat_ccc_cfg_changed(const struct bt_gatt_attr *attr,
				 u16_t value)
{
	notify_heartbeat = (value == BT_GATT_CCC_NOTIFY) ? 1 : 0;
}

static void data_ccc_cfg_changed(const struct bt_gatt_attr *attr,
				 u16_t value)
{
	notify_data = (value == BT_GATT_CCC_NOTIFY) ? 1 : 0;
}


static ssize_t write_cmd(struct bt_conn *conn,
				const struct bt_gatt_attr *attr,
				const void *buf, u16_t len, u16_t offset,
				u8_t flags)
{
	if (len == 0 || len > 20) {
		return 0;
	}

	static u8_t values[32];

	memcpy(values, buf, len);

	if (values[0] == 0x01 && len == 6) {
		mb_show_bits(&values[1], 5);
	} else if (values[0] == 0x02) {
		// You can insert your own command handlers here
		// ...
	} else if (values[0] >= ' ') {
		// Assume plain text - write message on display.
		// Make sure the string is zero terminated
		values[len] = 0;
		mb_show_msg(values, false);
	}

	return len;
}

static struct bt_gatt_attr attrs[] = {
	BT_GATT_PRIMARY_SERVICE(&service_uuid),

	BT_GATT_CHARACTERISTIC(&heartbeat_char_uuid.uuid,
			       BT_GATT_CHRC_NOTIFY,
			       BT_GATT_PERM_NONE, NULL, NULL, NULL),
	BT_GATT_CCC(heartbeat_ccc_cfg, heartbeat_ccc_cfg_changed),

	BT_GATT_CHARACTERISTIC(&data_char_uuid.uuid,
			       BT_GATT_CHRC_NOTIFY,
			       BT_GATT_PERM_NONE, NULL, NULL, NULL),
	BT_GATT_CCC(data_ccc_cfg, data_ccc_cfg_changed),

	BT_GATT_CHARACTERISTIC(&cmd_char_uuid.uuid,
			       BT_GATT_CHRC_WRITE,
			       BT_GATT_PERM_WRITE, NULL, write_cmd, NULL),
};

static struct bt_gatt_service gatt_svc = BT_GATT_SERVICE(attrs);

s8_t initDone = 0;

void gatt_service_init(void)
{
	k_work_init(&gatt_notify_work, send_next_notification);
	k_work_submit(&gatt_notify_work);
	
	bt_gatt_service_register(&gatt_svc);

	initDone = 1;
}

void gatt_service_heartbeat_notify()
{
	if (!initDone)
		return;

	if (!notify_heartbeat) {
		return;
	}

	bt_gatt_notify(NULL, &attrs[1], &hearbeat_count, 2);
}

void gatt_service_data_notify(const void *buf, u16_t len)
{
	if (!initDone)
		return;

	if (!notify_data) {
		return;
	}

	bt_gatt_notify(NULL, &attrs[4], buf, len);
}
```

## src/gatt_service.h
```c
#ifndef __GATT_SERVICE_H__
#define __GATT_SERVICE_H__

void gatt_service_init(void);
void send_message(u8_t type, u8_t* data, u16_t len);

enum {
    GATT_MSG_NONE,
    GATT_MSG_HEARTBEAT,
    GATT_MSG_DATA
};

#endif
```

## src/microbit_display.c
```c
#include <zephyr.h>
#include <misc/printk.h>
#include <gpio.h>
#include <device.h>
#include <string.h>

#include <display/mb_display.h>

#include "microbit_display.h"

static struct mb_image smiley_happy = 
	MB_IMAGE({ 0, 1, 0, 1, 0 },
			{ 0, 1, 0, 1, 0 },
			{ 0, 0, 0, 0, 0 },
			{ 1, 0, 0, 0, 1 },
			{ 0, 1, 1, 1, 0 });

static struct mb_image smiley_sad =
	MB_IMAGE({ 0, 1, 0, 1, 0 },
			{ 0, 1, 0, 1, 0 },
			{ 0, 0, 0, 0, 0 },
			{ 0, 1, 1, 1, 0 },
			{ 1, 0, 0, 0, 1 });

static const struct mb_image animation[] = {
	MB_IMAGE({ 0, 0, 0, 0, 0 },
			{ 0, 0, 0, 0, 0 },
			{ 0, 0, 1, 0, 0 },
			{ 0, 0, 0, 0, 0 },
			{ 0, 0, 0, 0, 0 }),
	MB_IMAGE({ 0, 0, 0, 0, 0 },
			{ 0, 1, 1, 1, 0 },
			{ 0, 1, 1, 1, 0 },
			{ 0, 1, 1, 1, 0 },
			{ 0, 0, 0, 0, 0 }),
	MB_IMAGE({ 1, 1, 1, 1, 1 },
			{ 1, 1, 1, 1, 1 },
			{ 1, 1, 0, 1, 1 },
			{ 1, 1, 1, 1, 1 },
			{ 1, 1, 1, 1, 1 }),
	MB_IMAGE({ 1, 1, 1, 1, 1 },
			{ 1, 0, 0, 0, 1 },
			{ 1, 0, 0, 0, 1 },
			{ 1, 0, 0, 0, 1 },
			{ 1, 1, 1, 1, 1 }),
};

void mb_show_smiley(bool happy)
{
	struct mb_display *disp = mb_display_get();

	/* Show a smiley-face */
	mb_display_image(disp, MB_DISPLAY_MODE_SINGLE, K_SECONDS(2),
        happy ? &smiley_happy : &smiley_sad, 1);
	k_sleep(K_SECONDS(2));
}

void mb_show_msg(const char* msg, bool block)
{
	struct mb_display *disp = mb_display_get();

	mb_display_print(disp, MB_DISPLAY_MODE_DEFAULT, K_MSEC(300), "%s", msg);
	if (block) {
		k_sleep(K_MSEC(300) * (strlen(msg)+1));
	}
}

void mb_show_bits(const u8_t* buf, u16_t len)
{
	struct mb_display *disp = mb_display_get();

	struct mb_image pixel = {};
	for (int y = 0; y < 5 && y < len; y++) {
			pixel.row[y] = buf[y] & 0x1f; // Only use first 5 bits.
	}
	mb_display_image(disp, MB_DISPLAY_MODE_SINGLE, K_FOREVER, &pixel, 1);
}

void mb_show_ready_animation()
{
	struct mb_display *disp = mb_display_get();
	/* Show a sequential animation */
	mb_display_image(disp, MB_DISPLAY_MODE_DEFAULT,
			 K_MSEC(150), animation, ARRAY_SIZE(animation));
	k_sleep(K_MSEC(150) * ARRAY_SIZE(animation));
}
```

## src/microbit_display.h
```c
#ifndef __MICROBIT_DISPLAY_H__
#define __MICROBIT_DISPLAY_H__

void mb_show_smiley(bool happy);
void mb_show_msg(const char* msg, bool block);
void mb_show_bits(const u8_t* buf, u16_t len);
void mb_show_ready_animation();

#endif
```
